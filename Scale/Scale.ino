// TM1637-master - Version: Latest 
#include <TM1637Display.h>

// LedControl - Version: Latest 
//#include <LedControl.h>



// Queuetue HX711 Library - Version: Latest 
#include <Q2HX711.h>

//ADC
#define SCK_PIN A3
#define DT_PIN A2
#define SCALE 100.0

//LCD
//#define CLK_LCD 9
//#define DIN_LCD 11
//#define CS_LOAD_LCD 10

#define CLK 10
#define DIO 11

#define RESET_WEIGHT_DELAY 1000

#define SCALE_CONST 366.15  //ADVALUE/gram

//Possible States
#define INIT 0
#define HOLDING_BTN 1
#define RESET_WEIGHT 2
#define WEIGHT_READING 3



//Sensor da balanca
Q2HX711 scale(DT_PIN, SCK_PIN);

//LCD
//LedControl lcd=LedControl(DIN_LCD,CLK_LCD,CS_LOAD_LCD,1);
//int refresh_rate = 250;
//char disp[8] = "";
//disp[0] = 'P';
//disp[1] = 'E';
//disp[2] = 'S';
//disp[3] = 'O';

//LCD
TM1637Display display(CLK, DIO);
const uint8_t SEG_DONE[] = {
	SEG_B | SEG_C | SEG_D | SEG_E | SEG_G,           // d
	SEG_A | SEG_B | SEG_C | SEG_D | SEG_E | SEG_F,   // O
	SEG_C | SEG_E | SEG_G,                           // n
	SEG_A | SEG_D | SEG_E | SEG_F | SEG_G            // E
	};
const uint8_t RST[] = {
	SEG_G, // -
	SEG_G, // -
	SEG_G, // -
	SEG_G  // -
	};



long scale_reading_grams = 0.0;
long scale_reading = 0.0;
long offset = 0.0;

int state=INIT;

int last_loop_time = 0;

int peso = 0;


void setup(){
  pinMode(12, INPUT_PULLUP);
  Serial.begin(9600);
  delay(100);
  
  display.setBrightness(7, true); // Turn on
  display.setSegments(RST);
  
  //faz reset ao offset. Le 10 vezes para retirar ruido da leitura
  offset = 0;
  for (int i = 0; i<10; i++){
    offset = scale.read() + offset;
  }
  offset = offset/10;
  
}

void loop() {
  
    int current_time = millis();
    
    //Faz monitor do botao de reset
    if (!digitalRead(12)){
      state = HOLDING_BTN;
      if(current_time - last_loop_time > RESET_WEIGHT_DELAY){
        last_loop_time = current_time;
        state = RESET_WEIGHT;
        Serial.println("Fiz Reset a balanca");
        // Done!
        display.setSegments(SEG_DONE);
        //faz reset ao offset. Le 5 vezes para retirar ruido da leitura
        offset = 0;
        for (int i = 0; i<5; i++){
          offset = scale.read() + offset;
        }
        offset = offset/5;
        
      } 
    }else{
      state = WEIGHT_READING;
      last_loop_time = current_time;
    }
    
    //Faz a animacao de reset no display
    /*if(state == HOLDING_BTN){
      
    }*/
    
    //Esta em modo de leitura faz a leitura da balanca
    if (state == WEIGHT_READING && scale.readyToSend()){
      //faz reset ao offset. Le 5 vezes para retirar ruido da leitura
      scale_reading = 0;
      for (int i = 0; i<5; i++){
        scale_reading = scale.read()+scale_reading;
      }
      scale_reading = scale_reading/5;
      
      //Serial.println(scale_reading);
      scale_reading_grams = ((scale_reading-offset)/SCALE_CONST);
      //Serial.println(scale_reading_grams);
    }
    
    //Faz a escrita do peso da balanca no display 
    if (state == WEIGHT_READING ){
      int peso = scale_reading_grams;
      if(peso>=0){
        display.showNumberDec(peso, false);
      }else{
        display.setSegments(RST);
      }      
    }
    
}
